## boards/arm/kitsune-evo/Kconfig
```kconfig
config BOARD_ENABLE_DCDC
    bool "Enable DCDC mode"
    select SOC_DCDC_NRF52X
    default n
    depends on BOARD_KITSUNE_EVO

config BOARD_ENABLE_DCDC_HV
    bool "Enable high voltage DCDC mode"
    select SOC_DCDC_NRF52X_HV
    default y
    depends on BOARD_KITSUNE_EVO
```

## boards/arm/kitsune-evo/Kconfig.board
```kconfig
config BOARD_KITSUNE_EVO
    bool "Kitsune EVO Keyboard"
    depends on SOC_NRF52840_QIAA
```

## boards/arm/kitsune-evo/Kconfig.defconfig
```kconfig
if BOARD_KITSUNE_EVO

config BOARD
    default "kisune_evo"

config ZMK_KEYBOARD_NAME
    default "Kitsune EVO"

if USB

config USB_NRFX
    default y

config USB_DEVICE_STACK
    default y

endif # USB

config BT_CTLR
    default BT

endif # BOARD_KITSUNE_EVO
```

## boards/arm/kitsune-evo/kitsune_evo_defconfig
```kconfig
CONFIG_SOC_SERIES_NRF52X=y
CONFIG_SOC_NRF52840_QIAA=y

# Setup MPU
CONFIG_ARM_MPU=y

# Setup GPIO
CONFIG_GPIO=y

# Setup SPI
CONFIG_SPI=y
CONFIG_SPI_NRFX=y

# Setup pinctrl
CONFIG_PINCTRL=y

# Setup writing to flash
CONFIG_USE_DT_CODE_PARTITION=y
CONFIG_MPU_ALLOW_FLASH_WRITE=y
CONFIG_NVS=y
CONFIG_SETTINGS_NVS=y
CONFIG_FLASH=y
CONFIG_FLASH_PAGE_LAYOUT=y
CONFIG_FLASH_MAP=y

# ZMK RGB Settings
CONFIG_ZMK_RGB_UNDERGLOW=y
CONFIG_WS2812_STRIP=y
CONFIG_ZMK_RGB_UNDERGLOW_AUTO_OFF_IDLE=y
CONFIG_ZMK_RGB_UNDERGLOW_BRT_START=50

# ZMK Power Management Settings
CONFIG_ZMK_SLEEP=y
CONFIG_ZMK_PM_SOFT_OFF=y

# ZMK Settings
CONFIG_BUILD_OUTPUT_UF2=y
CONFIG_ZMK_USB=y
CONFIG_ZMK_BLE=y
```

## boards/arm/kitsune-v0/Kconfig.board
```kconfig
config BOARD_KITSUNE_V0
    bool "Kitsune V0 Keyboard"
    depends on SOC_STM32F072XB
```

## boards/arm/kitsune-v0/Kconfig.defconfig
```kconfig
if BOARD_KITSUNE_V0

config ZMK_KEYBOARD_NAME
    default "Kitsune V0"

endif # BOARD_KITSUNE_V0
```

## boards/arm/kitsune/Kconfig.defconfig
```kconfig
if BOARD_KITSUNE

config BOARD
    default "kitsune"

config ZMK_KEYBOARD_NAME
    default "Kitsune"

config ZMK_RGB_UNDERGLOW
    select SPI
    select WS2812_STRIP

endif # BOARD_KITSUNE
```

## boards/arm/kitsune/kitsune_defconfig
```kconfig
CONFIG_SOC_SERIES_STM32F0X=y
CONFIG_SOC_STM32F072XB=y

# Setup clock
CONFIG_CLOCK_CONTROL=y
CONFIG_SYS_CLOCK_HW_CYCLES_PER_SEC=48000000

# Setup GPIO
CONFIG_GPIO=y

# Setup SPI
CONFIG_SPI=y

# Setup pinctrl
CONFIG_PINCTRL=y

# ZMK Settings
CONFIG_ZMK_KSCAN_MATRIX_POLLING=y
CONFIG_ZMK_USB=y

# ZMK RGB Settings
CONFIG_ZMK_RGB_UNDERGLOW=y
CONFIG_WS2812_STRIP=y
# CONFIG_ZMK_RGB_UNDERGLOW_EXT_POWER=n
CONFIG_ZMK_RGB_UNDERGLOW_AUTO_OFF_IDLE=y
CONFIG_ZMK_RGB_UNDERGLOW_BRT_START=50

# Boot Retention Settings
CONFIG_RETAINED_MEM=y
CONFIG_RETENTION=y
CONFIG_RETENTION_BOOT_MODE=y
```

## boards/arm/kitsune_evo/Kconfig.board
```kconfig
config BOARD_KITSUNE_EVO
    bool "Standard Keyboard"
    depends on SOC_NRF52840_QIAA
```
